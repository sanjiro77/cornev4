## config/west.yml
```yaml
manifest:
  remotes:
    - name: zmkfirmware
      url-base: https://github.com/zmkfirmware
    - name: forkedzmk
      url-base: https://github.com/forkedzmk
  projects:
    - name: zmk
      remote: forkedzmk
      revision: specificpr
      import: app/west.yml
  self:
    path: config
```
